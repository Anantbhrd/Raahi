/*
  SMART BUS TRACKING SYSTEM - BUS-SIDE UNIT (WOKWI PROTOTYPE)
  MCU: ESP32 DevKit C V4

  Hardware represented in the diagram:
    - MFRC522 RFID reader
    - NEO-6M GPS custom Wokwi chip (NMEA output simulator)
    - SIM800L GSM custom Wokwi chip (AT/HTTP simulator)
    - I2C 16x2 LCD
    - 1 green status LED + 220 ohm resistor
    - buzzer
    - 1 pushbutton for manual telemetry sync

  Important:
    - GPS coordinates are generated by a custom Wokwi simulation chip.
    - The SIM800L custom chip simulates AT commands and HTTP success; it does
      not connect to a cellular network or a real server.
    - Before physical use, set GSM_APN and API_URL to real values and verify
      the chosen modem/network. A real SIM800L is 2G-only and needs a separate,
      high-current power supply.
*/

#include <SPI.h>
#include <MFRC522.h>
#include <Wire.h>
#include <LiquidCrystal_I2C.h>
#include <TinyGPSPlus.h>

// ---------------- Pins ----------------
static const uint8_t RFID_SS_PIN   = 5;
static const uint8_t RFID_RST_PIN  = 4;
static const uint8_t RFID_SCK_PIN  = 18;
static const uint8_t RFID_MISO_PIN = 19;
static const uint8_t RFID_MOSI_PIN = 23;

static const uint8_t GPS_RX_PIN = 16;  // ESP32 receives GPS TX here
static const uint8_t GPS_TX_PIN = 17;  // Optional: ESP32 TX to GPS RX
static const uint8_t GSM_RX_PIN = 26;  // ESP32 receives modem TX here
static const uint8_t GSM_TX_PIN = 27;  // ESP32 TX to modem RX

static const uint8_t LCD_SDA_PIN = 21;
static const uint8_t LCD_SCL_PIN = 22;
static const uint8_t STATUS_LED_PIN = 14;
static const uint8_t BUZZER_PIN = 25;
static const uint8_t SYNC_BUTTON_PIN = 32; // button to GND; INPUT_PULLUP

// ---------------- Configuration ----------------
const char *BUS_ID = "BUS-01";
// Change these before using physical hardware.
const char *GSM_APN = "internet";
const char *API_URL = "http://YOUR_SERVER_HOST/api/buses/telemetry";
const uint32_t TELEMETRY_INTERVAL_MS = 30000;

// Demo allow-list: Wokwi blue/green card presets.
const char *allowedUIDs[] = {"01:02:03:04", "11:22:33:44"};
const size_t allowedUIDCount = sizeof(allowedUIDs) / sizeof(allowedUIDs[0]);

MFRC522 rfid(RFID_SS_PIN, RFID_RST_PIN);
TinyGPSPlus gps;
HardwareSerial gpsSerial(2);
HardwareSerial gsmSerial(1);
LiquidCrystal_I2C lcd(0x27, 16, 2);

bool gsmReady = false;
bool lastButtonReading = HIGH;
bool stableButtonState = HIGH;
unsigned long lastButtonDebounceMs = 0;
unsigned long ledOffAt = 0;
unsigned long eventDisplayUntil = 0;
unsigned long lastTelemetryMs = 0;
unsigned long lastGpsFixMs = 0;
String eventLine1;
String eventLine2;

// ---------------- Utility / LCD ----------------
void writeLCDLine(uint8_t row, String text) {
  if (text.length() > 16) text = text.substring(0, 16);
  lcd.setCursor(0, row);
  lcd.print(text);
  for (size_t i = text.length(); i < 16; ++i) lcd.print(' ');
}

void showLCDMessage(const String &line1, const String &line2, uint32_t durationMs = 2500) {
  eventLine1 = line1;
  eventLine2 = line2;
  eventDisplayUntil = millis() + durationMs;
  writeLCDLine(0, eventLine1);
  writeLCDLine(1, eventLine2);
}

bool hasFreshGPSFix() {
  return gps.location.isValid() && (millis() - lastGpsFixMs < 6000);
}

void refreshLCD() {
  if (millis() < eventDisplayUntil) {
    writeLCDLine(0, eventLine1);
    writeLCDLine(1, eventLine2);
    return;
  }

  writeLCDLine(0, "BUS UNIT READY");
  String line2 = hasFreshGPSFix() ? "GPS:FIX " : "GPS:WAIT ";
  line2 += gsmReady ? "GSM:OK" : "GSM:ERR";
  writeLCDLine(1, line2);
}

// ---------------- RFID ----------------
String getCardUID() {
  String uid;
  for (byte i = 0; i < rfid.uid.size; ++i) {
    if (i) uid += ':';
    if (rfid.uid.uidByte[i] < 0x10) uid += '0';
    uid += String(rfid.uid.uidByte[i], HEX);
  }
  uid.toUpperCase();
  return uid;
}

bool uidIsAuthorized(const String &uid) {
  for (size_t i = 0; i < allowedUIDCount; ++i) {
    if (uid.equalsIgnoreCase(allowedUIDs[i])) return true;
  }
  return false;
}

// ---------------- GSM AT helpers ----------------
void clearGSMInput() {
  while (gsmSerial.available()) (void)gsmSerial.read();
}

bool waitForGSMToken(const String &token, uint32_t timeoutMs) {
  String response;
  response.reserve(160);
  const unsigned long start = millis();
  while (millis() - start < timeoutMs) {
    while (gsmSerial.available()) {
      const char c = (char)gsmSerial.read();
      response += c;
      if (response.indexOf(token) >= 0) {
        Serial.printf("[GSM RX] %s\n", response.c_str());
        return true;
      }
      if (response.length() > 300) response.remove(0, 150);
    }
    delay(1);
  }
  Serial.printf("[GSM TIMEOUT] waiting for '%s'; response='%s'\n",
                token.c_str(), response.c_str());
  return false;
}

bool sendATCommand(const String &command, const String &expected,
                   uint32_t timeoutMs = 2500) {
  clearGSMInput();
  Serial.printf("[GSM TX] %s\n", command.c_str());
  gsmSerial.println(command);
  return waitForGSMToken(expected, timeoutMs);
}

bool initializeGSM() {
  // A real SIM800L needs a valid SIM, network coverage, antenna, and correct APN.
  if (!sendATCommand("AT", "OK", 3000)) return false;
  if (!sendATCommand("ATE0", "OK", 2500)) return false;
  if (!sendATCommand("AT+SAPBR=3,1,\"Contype\",\"GPRS\"", "OK")) return false;
  if (!sendATCommand(String("AT+SAPBR=3,1,\"APN\",\"") + GSM_APN + "\"", "OK")) return false;
  if (!sendATCommand("AT+SAPBR=1,1", "OK", 12000)) return false;
  Serial.println(F("[GSM] Modem/bearer ready (simulated in Wokwi)."));
  return true;
}

// Posts telemetry to the website/backend. In Wokwi, the custom SIM800L chip
// simulates an HTTP 200 response. Physical hardware needs a reachable API URL.
bool postTelemetry(const String &eventType, const String &uid = "") {
  if (!gsmReady) {
    Serial.println(F("[TELEMETRY] Skipped: GSM is not ready."));
    return false;
  }

  String payload = "{\"bus_id\":\"" + String(BUS_ID) + "\"";
  payload += ",\"event\":\"" + eventType + "\"";
  if (uid.length()) payload += ",\"card_uid\":\"" + uid + "\"";
  payload += ",\"gps_fix\":";
  payload += hasFreshGPSFix() ? "true" : "false";
  if (hasFreshGPSFix()) {
    payload += ",\"latitude\":" + String(gps.location.lat(), 6);
    payload += ",\"longitude\":" + String(gps.location.lng(), 6);
  } else {
    payload += ",\"latitude\":null,\"longitude\":null";
  }
  payload += ",\"uptime_ms\":" + String(millis()) + "}";

  bool httpStarted = false;
  bool success = false;

  if (!sendATCommand("AT+HTTPINIT", "OK")) goto cleanup;
  httpStarted = true;
  if (!sendATCommand("AT+HTTPPARA=\"CID\",1", "OK")) goto cleanup;
  if (!sendATCommand(String("AT+HTTPPARA=\"URL\",\"") + API_URL + "\"", "OK")) goto cleanup;
  if (!sendATCommand("AT+HTTPPARA=\"CONTENT\",\"application/json\"", "OK")) goto cleanup;
  if (!sendATCommand(String("AT+HTTPDATA=") + payload.length() + ",10000", "DOWNLOAD", 5000)) goto cleanup;

  Serial.printf("[TELEMETRY JSON] %s\n", payload.c_str());
  gsmSerial.print(payload); // SIM800L expects exactly the announced data length.
  if (!waitForGSMToken("OK", 6000)) goto cleanup;

  clearGSMInput();
  gsmSerial.println("AT+HTTPACTION=1");
  success = waitForGSMToken("+HTTPACTION: 1,200", 15000);
  if (success) {
    Serial.println(F("[TELEMETRY] HTTP POST accepted by modem simulator."));
  } else {
    Serial.println(F("[TELEMETRY] Upload failed; check APN/API URL on physical hardware."));
  }

cleanup:
  if (httpStarted) sendATCommand("AT+HTTPTERM", "OK", 2500);
  if (!success) Serial.println(F("[TELEMETRY] This Wokwi result is simulated, not a real server upload."));
  return success;
}

// ---------------- GPS / event loop ----------------
void processGPS() {
  while (gpsSerial.available()) {
    const char c = (char)gpsSerial.read();
    if (gps.encode(c) && gps.location.isUpdated() && gps.location.isValid()) {
      lastGpsFixMs = millis();
      Serial.printf("[GPS] lat=%.6f, lon=%.6f, speed=%.1f km/h\n",
                    gps.location.lat(), gps.location.lng(), gps.speed.kmph());
    }
  }
}

void processRFID() {
  if (!rfid.PICC_IsNewCardPresent() || !rfid.PICC_ReadCardSerial()) return;

  const String uid = getCardUID();
  static String previousUID;
  static unsigned long previousScanMs = 0;
  const unsigned long now = millis();
  const bool duplicate = (uid == previousUID && now - previousScanMs < 2500);
  previousUID = uid;
  previousScanMs = now;

  if (!duplicate) {
    if (uidIsAuthorized(uid)) {
      digitalWrite(STATUS_LED_PIN, HIGH);
      ledOffAt = now + 1200;
      tone(BUZZER_PIN, 1900, 140);
      showLCDMessage("ACCESS GRANTED", "BOARDING LOGGED", 3000);
      Serial.printf("[RFID] ACCESS GRANTED | UID=%s\n", uid.c_str());
      Serial.println(F("[EVENT] Authorized boarding event queued for telemetry."));
      (void)postTelemetry("boarding", uid);
    } else {
      digitalWrite(STATUS_LED_PIN, LOW);
      ledOffAt = 0;
      tone(BUZZER_PIN, 650, 350);
      showLCDMessage("ACCESS DENIED", "CARD NOT REGISTERED", 3000);
      Serial.printf("[RFID] ACCESS DENIED | UID=%s\n", uid.c_str());
      (void)postTelemetry("unauthorized_card", uid);
    }
  }

  rfid.PICC_HaltA();
  rfid.PCD_StopCrypto1();
}

void processSyncButton() {
  const bool reading = digitalRead(SYNC_BUTTON_PIN);
  if (reading != lastButtonReading) lastButtonDebounceMs = millis();
  if (millis() - lastButtonDebounceMs > 35 && reading != stableButtonState) {
    stableButtonState = reading;
    if (stableButtonState == LOW) {
      showLCDMessage("SYNC REQUESTED", "SENDING LOCATION", 3000);
      Serial.println(F("[BUTTON] Manual telemetry sync requested."));
      (void)postTelemetry("manual_sync");
    }
  }
  lastButtonReading = reading;
}

void setup() {
  Serial.begin(115200);
  delay(250);

  pinMode(STATUS_LED_PIN, OUTPUT);
  pinMode(BUZZER_PIN, OUTPUT);
  pinMode(SYNC_BUTTON_PIN, INPUT_PULLUP);
  digitalWrite(STATUS_LED_PIN, LOW);

  Wire.begin(LCD_SDA_PIN, LCD_SCL_PIN);
  lcd.init();
  lcd.backlight();
  writeLCDLine(0, "SMART BUS UNIT");
  writeLCDLine(1, "INITIALIZING...");

  SPI.begin(RFID_SCK_PIN, RFID_MISO_PIN, RFID_MOSI_PIN, RFID_SS_PIN);
  rfid.PCD_Init();
  delay(50);

  gpsSerial.begin(9600, SERIAL_8N1, GPS_RX_PIN, GPS_TX_PIN);
  gsmSerial.begin(9600, SERIAL_8N1, GSM_RX_PIN, GSM_TX_PIN);

  Serial.println();
  Serial.println(F("=== SMART BUS TRACKING: BUS-SIDE UNIT ==="));
  Serial.println(F("RFID access + GPS NMEA + GSM HTTP telemetry"));
  Serial.println(F("Blue/Green Wokwi cards are authorized in this demo."));

  showLCDMessage("BUS UNIT READY", "GPS:WAIT GSM:INIT", 2000);
  gsmReady = initializeGSM();
  if (gsmReady) {
    showLCDMessage("GSM INITIALIZED", "WAITING FOR GPS", 2000);
  } else {
    showLCDMessage("GSM INIT FAILED", "CHECK MODEM/APN", 3000);
  }

  lastTelemetryMs = millis();
  Serial.println(F("Press the sync button to send a manual telemetry payload."));
  Serial.println(F("Replace API_URL and GSM_APN before using real hardware."));
}

void loop() {
  processGPS();
  processRFID();
  processSyncButton();

  if (ledOffAt && millis() >= ledOffAt) {
    digitalWrite(STATUS_LED_PIN, LOW);
    ledOffAt = 0;
  }

  if (gsmReady && millis() - lastTelemetryMs >= TELEMETRY_INTERVAL_MS) {
    lastTelemetryMs = millis();
    (void)postTelemetry("periodic_location");
  }

  static unsigned long lastLCDRefresh = 0;
  if (millis() - lastLCDRefresh >= 350) {
    lastLCDRefresh = millis();
    refreshLCD();
  }
}
